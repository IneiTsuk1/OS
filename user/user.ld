/* Linker script for user-space ELF32 programs running on MyOS.
 *
 * Load address: 0x400000 (4 MiB) — well above the kernel's identity-mapped
 * region (which ends around 1–2 MiB depending on kernel size) and below the
 * user stack at 0xBFFFF000.
 *
 * The kernel copies kernel PDEs into every user page directory, so virtual
 * addresses below PDE_KERNEL_END (the kernel region) are already occupied.
 * 0x400000 sits in PDE index 1 (covers 4–8 MiB), safely above the kernel.
 *
 * Section alignment:
 *   Each section is aligned to a 4 KiB page boundary so that the ELF loader
 *   can map them with independent page permissions:
 *
 *     .text           — R-X  (execute, no write)
 *     .rodata         — R--  (read-only, no execute)
 *     .data + .bss    — RW-  (read-write, no execute)
 *
 *   Without page alignment .rodata shares a page with the tail of .text
 *   (effectively executable) and .data shares a page with the tail of
 *   .rodata (effectively read-only).  The ELF loader maps whole pages, so
 *   mis-aligned sections silently inherit the wrong permissions.
 *
 * Discarded sections:
 *   .eh_frame / .eh_frame_hdr — GCC exception-handling unwind tables.
 *     Freestanding programs with no C++ exceptions and no libgcc unwinder
 *     have no use for these.  Keeping them wastes ~1 KiB per binary and
 *     adds a spurious read-only segment between .text and .rodata.
 *
 *   .got / .got.plt — the Global Offset Table.
 *     Generated by ld even for fully static binaries.  Our programs have no
 *     dynamic relocations, so the GOT is empty and safe to discard.
 *     Keeping it causes ld to place it at the start of the RW segment,
 *     slightly before .data, which is harmless but untidy.
 *
 *   .note* / .comment — build-system metadata, not needed at runtime.
 */

ENTRY(_start)

SECTIONS
{
    . = 0x400000;

    /* ---- read + execute -------------------------------------------------- */
    .text : {
        *(.text*)
    }

    . = ALIGN(4096);

    /* ---- read-only -------------------------------------------------------- */
    .rodata : {
        *(.rodata*)
    }

    . = ALIGN(4096);

    /* ---- read + write ----------------------------------------------------- */
    .data : {
        *(.data*)
    }

    .bss : {
        *(COMMON)
        *(.bss*)
    }

    /* End of BSS — starting point for a future SYS_BRK heap extension. */
    _end = .;

    /* ---- discarded sections ----------------------------------------------- */
    /DISCARD/ : {
        *(.eh_frame*)       /* C++ unwind tables — unused in freestanding CRT  */
        *(.eh_frame_hdr*)
        *(.note*)           /* Build notes                                      */
        *(.comment)         /* Compiler version string                          */
    }
}
